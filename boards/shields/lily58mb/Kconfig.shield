## boards/shields/lily58mb/Kconfig.shield
```kconfig
# Copyright (c) 2020 Pete Johanson
# SPDX-License-Identifier: MIT

config SHIELD_LILY58MB_LEFT
    def_bool $(shields_list_contains,lily58mb_left)

config SHIELD_LILY58MB_RIGHT
    def_bool $(shields_list_contains,lily58mb_right)
```
